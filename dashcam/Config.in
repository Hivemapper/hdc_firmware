## dashcam/Config.in
```kconfig
source "$BR2_EXTERNAL_DASHCAM_PATH/package/camera-api/Config.in"
source "$BR2_EXTERNAL_DASHCAM_PATH/package/camera-bridge/Config.in"
source "$BR2_EXTERNAL_DASHCAM_PATH/package/camera-node/Config.in"
source "$BR2_EXTERNAL_DASHCAM_PATH/package/api-health-manager/Config.in"
source "$BR2_EXTERNAL_DASHCAM_PATH/package/camera-scripts/Config.in"
source "$BR2_EXTERNAL_DASHCAM_PATH/package/data-logger/Config.in"
source "$BR2_EXTERNAL_DASHCAM_PATH/package/led-controller/Config.in"
source "$BR2_EXTERNAL_DASHCAM_PATH/package/lorawan-logger/Config.in"
source "$BR2_EXTERNAL_DASHCAM_PATH/package/onboard-updater/Config.in"
source "$BR2_EXTERNAL_DASHCAM_PATH/package/python-transitions/Config.in"
source "$BR2_EXTERNAL_DASHCAM_PATH/package/zig-aarch64/Config.in"
source "$BR2_EXTERNAL_DASHCAM_PATH/package/folder_purger/Config.in"
source "$BR2_EXTERNAL_DASHCAM_PATH/package/hdc-acl/Config.in"
source "$BR2_EXTERNAL_DASHCAM_PATH/package/yolov8/Config.in"
source "$BR2_EXTERNAL_DASHCAM_PATH/package/python-gitpython/Config.in"
source "$BR2_EXTERNAL_DASHCAM_PATH/package/python-scikit-build/Config.in"
source "$BR2_EXTERNAL_DASHCAM_PATH/package/python-opencv-python/Config.in"
source "$BR2_EXTERNAL_DASHCAM_PATH/package/python-pybind11/Config.in"
source "$BR2_EXTERNAL_DASHCAM_PATH/package/python-thop/Config.in"
source "$BR2_EXTERNAL_DASHCAM_PATH/package/python-ultralytics/Config.in"
source "$BR2_EXTERNAL_DASHCAM_PATH/package/python-sympy/Config.in"
source "$BR2_EXTERNAL_DASHCAM_PATH/package/python-humanfriendly/Config.in"
source "$BR2_EXTERNAL_DASHCAM_PATH/package/python-mpmath/Config.in"
source "$BR2_EXTERNAL_DASHCAM_PATH/package/python-hypothesis/Config.in"
source "$BR2_EXTERNAL_DASHCAM_PATH/package/python-types-dataclasses/Config.in"
source "$BR2_EXTERNAL_DASHCAM_PATH/package/python-yappi/Config.in"
source "$BR2_EXTERNAL_DASHCAM_PATH/package/object-detection/Config.in"
source "$BR2_EXTERNAL_DASHCAM_PATH/package/usb-write/Config.in"
```

## dashcam/configs/raspberrypicm4io_64_dev_dashcam_defconfig
```kconfig
BR2_aarch64=y
BR2_cortex_a72=y
BR2_ARM_FPU_VFPV4=y
BR2_CCACHE=y
BR2_CCACHE_DIR="$(TOPDIR)/../.buildroot-ccache"
BR2_TOOLCHAIN_EXTERNAL=y
BR2_TOOLCHAIN_EXTERNAL_BOOTLIN=y
BR2_TOOLCHAIN_EXTERNAL_BOOTLIN_AARCH64_GLIBC_STABLE=y
BR2_TARGET_GENERIC_HOSTNAME="dashcam"
BR2_TARGET_GENERIC_ISSUE="Welcome to Dashcam"
BR2_INIT_SYSTEMD=y
# BR2_TARGET_GENERIC_GETTY is not set
# BR2_TARGET_GENERIC_REMOUNT_ROOTFS_RW is not set
BR2_SYSTEM_DHCP="eth0"
BR2_SYSTEM_DEFAULT_PATH="/bin:/sbin:/usr/bin:/usr/sbin"
BR2_ROOTFS_USERS_TABLES="$(BR2_EXTERNAL_DASHCAM_PATH)/board/raspberrypicm4io_64_dev/users"
BR2_ROOTFS_OVERLAY="$(BR2_EXTERNAL_DASHCAM_PATH)/board/raspberrypicm4io_64_dev/overlays/common $(BR2_EXTERNAL_DASHCAM_PATH)/board/raspberrypicm4io_64_dev/overlays/dev"
BR2_ROOTFS_POST_BUILD_SCRIPT="$(BR2_EXTERNAL_DASHCAM_PATH)/board/raspberrypicm4io_64_dev/post_build.sh"
BR2_ROOTFS_POST_FAKEROOT_SCRIPT="$(BR2_EXTERNAL_DASHCAM_PATH)/board/raspberrypicm4io_64_dev/fakeroot.sh"
BR2_ROOTFS_POST_IMAGE_SCRIPT="$(BR2_EXTERNAL_DASHCAM_PATH)/board/raspberrypicm4io_64_dev/post_image.sh"
BR2_LINUX_KERNEL=y
BR2_LINUX_KERNEL_CUSTOM_TARBALL=y
BR2_LINUX_KERNEL_CUSTOM_TARBALL_LOCATION="$(call github,raspberrypi,linux,581049d718caf95f5feb00607ac748d5841cf27c)/linux-581049d718caf95f5feb00607ac748d5841cf27c.tar.gz"
BR2_LINUX_KERNEL_DEFCONFIG="bcm2711"
BR2_LINUX_KERNEL_CONFIG_FRAGMENT_FILES="$(BR2_EXTERNAL_DASHCAM_PATH)/board/raspberrypicm4io_64_dev/linux.fragment"
BR2_LINUX_KERNEL_NEEDS_HOST_OPENSSL=y
BR2_PACKAGE_BUSYBOX_INDIVIDUAL_BINARIES=y
BR2_PACKAGE_FFMPEG=y
BR2_PACKAGE_FFMPEG_FFPLAY=y
BR2_PACKAGE_JQ=y
BR2_PACKAGE_E2FSPROGS=y
BR2_PACKAGE_E2FSPROGS_RESIZE2FS=y
BR2_PACKAGE_MMC_UTILS=y
BR2_PACKAGE_NTFS_3G=y
BR2_PACKAGE_BRCMFMAC_SDIO_FIRMWARE_RPI=y
BR2_PACKAGE_BRCMFMAC_SDIO_FIRMWARE_RPI_WIFI=y
BR2_PACKAGE_RPI_FIRMWARE=y
BR2_PACKAGE_RPI_FIRMWARE_VARIANT_PI4=y
BR2_PACKAGE_RPI_FIRMWARE_VARIANT_PI4_X=y
BR2_PACKAGE_RPI_FIRMWARE_VARIANT_PI4_DB=y
BR2_PACKAGE_RPI_FIRMWARE_CONFIG_FILE="$(BR2_EXTERNAL_DASHCAM_PATH)/board/raspberrypicm4io_64_dev/config.txt"
BR2_PACKAGE_MINICOM=y
BR2_PACKAGE_PARTED=y
BR2_PACKAGE_USBMOUNT=y
BR2_PACKAGE_PYTHON_SERIAL_ASYNCIO=y
BR2_PACKAGE_PYTHON_SMBUS_CFFI=y
BR2_PACKAGE_LIBOPENSSL_BIN=y
BR2_PACKAGE_LIBFUSE=y
BR2_PACKAGE_WEBP=y
BR2_PACKAGE_LIBGPIOD=y
BR2_PACKAGE_LIBGPIOD_TOOLS=y
BR2_PACKAGE_LIBCAMERA_V4L2=y
BR2_PACKAGE_LIBCAMERA_APPS=y
BR2_PACKAGE_LIBYUV=y
BR2_PACKAGE_FMT=y
BR2_PACKAGE_AVAHI=y
BR2_PACKAGE_AVAHI_DAEMON=y
BR2_PACKAGE_DHCPCD=y
BR2_PACKAGE_DNSMASQ=y
BR2_PACKAGE_HOSTAPD=y
BR2_PACKAGE_LLDPD=y
BR2_PACKAGE_MJPG_STREAMER=y
BR2_PACKAGE_OPENSSH=y
BR2_PACKAGE_WIRELESS_TOOLS=y
BR2_PACKAGE_WPA_SUPPLICANT=y
BR2_PACKAGE_WPA_SUPPLICANT_AP_SUPPORT=y
BR2_PACKAGE_WPA_SUPPLICANT_CLI=y
BR2_PACKAGE_SUDO=y
BR2_PACKAGE_HTOP=y
BR2_PACKAGE_IOTOP=y
BR2_PACKAGE_RAUC=y
BR2_PACKAGE_RAUC_DBUS=y
BR2_PACKAGE_RAUC_NETWORK=y
BR2_PACKAGE_RAUC_JSON=y
BR2_TARGET_ROOTFS_SQUASHFS=y
# BR2_TARGET_ROOTFS_TAR is not set
BR2_TARGET_UBOOT=y
BR2_TARGET_UBOOT_BOARD_DEFCONFIG="rpi_arm64"
BR2_TARGET_UBOOT_CONFIG_FRAGMENT_FILES="$(BR2_EXTERNAL_DASHCAM_PATH)/board/raspberrypicm4io_64_dev/uboot.fragment"
BR2_TARGET_UBOOT_NEEDS_OPENSSL=y
BR2_PACKAGE_HOST_DOSFSTOOLS=y
BR2_PACKAGE_HOST_E2FSPROGS=y
BR2_PACKAGE_HOST_GENIMAGE=y
BR2_PACKAGE_HOST_MTOOLS=y
BR2_PACKAGE_HOST_RASPBERRYPI_USBBOOT=y
BR2_PACKAGE_HOST_RAUC=y
BR2_PACKAGE_HOST_UBOOT_TOOLS=y
BR2_PACKAGE_HOST_UBOOT_TOOLS_ENVIMAGE=y
BR2_PACKAGE_HOST_UBOOT_TOOLS_ENVIMAGE_SIZE="0x4000"
BR2_PACKAGE_HOST_UBOOT_TOOLS_ENVIMAGE_REDUNDANT=y
BR2_PACKAGE_CAMERA_BRIDGE=y
BR2_PACKAGE_DEBUGGER=y
BR2_PACKAGE_FOLDER_PURGER=y
BR2_PACKAGE_CAMERA_NODE=y
BR2_PACKAGE_API_HEALTH_MANAGER=y
BR2_PACKAGE_CAMERA_SCRIPTS=y
BR2_PACKAGE_DATA_LOGGER=y
BR2_PACKAGE_LED_CONTROLLER=y
BR2_PACKAGE_LORAWAN_LOGGER=y
BR2_PACKAGE_HDC_ACL=y
BR2_PACKAGE_ONBOARD_UPDATER=y
BR2_PACKAGE_LINUX_TOOLS_PERF=y
BR2_PACKAGE_LINUX_TOOLS_PERF_TUI=y
BR2_PACKAGE_YOLOV8=y
BR2_PACKAGE_OBJECT_DETECTION=y
BR2_PACKAGE_USB_WRITE=y
# Added for dependency resolution
BR2_INSTALL_LIBSTDCPP=y
BR2_USE_WCHAR=y
BR2_PACKAGE_UTIL_LINUX=y
BR2_TOOLCHAIN_HEADERS_AT_LEAST_3_14=y
BR2_PACKAGE_UTIL_LINUX_SCHEDUTILS=y
```

## dashcam/configs/raspberrypicm4io_64_prod_dashcam_defconfig
```kconfig
BR2_aarch64=y
BR2_cortex_a72=y
BR2_ARM_FPU_VFPV4=y
BR2_CCACHE=y
BR2_CCACHE_DIR="$(TOPDIR)/../.buildroot-ccache"
BR2_TOOLCHAIN_EXTERNAL=y
BR2_TOOLCHAIN_EXTERNAL_BOOTLIN=y
BR2_TOOLCHAIN_EXTERNAL_BOOTLIN_AARCH64_GLIBC_STABLE=y
BR2_TARGET_GENERIC_HOSTNAME="dashcam"
BR2_TARGET_GENERIC_ISSUE="Welcome to Dashcam"
BR2_INIT_SYSTEMD=y
# BR2_TARGET_ENABLE_ROOT_LOGIN is not set
# BR2_TARGET_GENERIC_GETTY is not set
# BR2_TARGET_GENERIC_REMOUNT_ROOTFS_RW is not set
BR2_SYSTEM_DHCP="eth0"
BR2_SYSTEM_DEFAULT_PATH="/bin:/sbin:/usr/bin:/usr/sbin"
BR2_ROOTFS_USERS_TABLES="$(BR2_EXTERNAL_DASHCAM_PATH)/board/raspberrypicm4io_64_prod/users"
BR2_ROOTFS_OVERLAY="$(BR2_EXTERNAL_DASHCAM_PATH)/board/raspberrypicm4io_64_prod/overlays/common"
BR2_ROOTFS_POST_BUILD_SCRIPT="$(BR2_EXTERNAL_DASHCAM_PATH)/board/raspberrypicm4io_64_prod/post_build.sh"
BR2_ROOTFS_POST_FAKEROOT_SCRIPT="$(BR2_EXTERNAL_DASHCAM_PATH)/board/raspberrypicm4io_64_prod/fakeroot.sh"
BR2_ROOTFS_POST_IMAGE_SCRIPT="$(BR2_EXTERNAL_DASHCAM_PATH)/board/raspberrypicm4io_64_prod/post_image.sh"
BR2_LINUX_KERNEL=y
BR2_LINUX_KERNEL_CUSTOM_TARBALL=y
BR2_LINUX_KERNEL_CUSTOM_TARBALL_LOCATION="$(call github,raspberrypi,linux,581049d718caf95f5feb00607ac748d5841cf27c)/linux-581049d718caf95f5feb00607ac748d5841cf27c.tar.gz"
BR2_LINUX_KERNEL_DEFCONFIG="bcm2711"
BR2_LINUX_KERNEL_CONFIG_FRAGMENT_FILES="$(BR2_EXTERNAL_DASHCAM_PATH)/board/raspberrypicm4io_64_prod/linux.fragment"
BR2_LINUX_KERNEL_NEEDS_HOST_OPENSSL=y
BR2_PACKAGE_JQ=y
BR2_PACKAGE_BRCMFMAC_SDIO_FIRMWARE_RPI=y
BR2_PACKAGE_BRCMFMAC_SDIO_FIRMWARE_RPI_WIFI=y
BR2_PACKAGE_RPI_FIRMWARE=y
BR2_PACKAGE_RPI_FIRMWARE_VARIANT_PI4=y
BR2_PACKAGE_RPI_FIRMWARE_CONFIG_FILE="$(BR2_EXTERNAL_DASHCAM_PATH)/board/raspberrypicm4io_64_prod/config.txt"
BR2_PACKAGE_RPI_USERLAND=y
BR2_PACKAGE_USBMOUNT=y
BR2_PACKAGE_LIBCAMERA_V4L2=y
BR2_PACKAGE_DHCPCD=y
BR2_PACKAGE_DNSMASQ=y
BR2_PACKAGE_HOSTAPD=y
BR2_PACKAGE_WIRELESS_TOOLS=y
BR2_PACKAGE_SUDO=y
BR2_PACKAGE_RAUC=y
BR2_PACKAGE_RAUC_DBUS=y
BR2_PACKAGE_RAUC_NETWORK=y
BR2_PACKAGE_RAUC_JSON=y
BR2_TARGET_ROOTFS_SQUASHFS=y
# BR2_TARGET_ROOTFS_TAR is not set
BR2_TARGET_UBOOT=y
BR2_TARGET_UBOOT_BOARD_DEFCONFIG="rpi_arm64"
BR2_TARGET_UBOOT_CONFIG_FRAGMENT_FILES="$(BR2_EXTERNAL_DASHCAM_PATH)/board/raspberrypicm4io_64_prod/uboot.fragment"
BR2_TARGET_UBOOT_NEEDS_OPENSSL=y
BR2_PACKAGE_HOST_DOSFSTOOLS=y
BR2_PACKAGE_HOST_E2FSPROGS=y
BR2_PACKAGE_HOST_GENIMAGE=y
BR2_PACKAGE_HOST_MTOOLS=y
BR2_PACKAGE_HOST_RASPBERRYPI_USBBOOT=y
BR2_PACKAGE_HOST_RAUC=y
BR2_PACKAGE_HOST_UBOOT_TOOLS=y
BR2_PACKAGE_HOST_UBOOT_TOOLS_ENVIMAGE=y
BR2_PACKAGE_HOST_UBOOT_TOOLS_ENVIMAGE_SIZE="0x4000"
BR2_PACKAGE_HOST_UBOOT_TOOLS_ENVIMAGE_REDUNDANT=y
BR2_PACKAGE_CAMERA_BRIDGE=y
BR2_PACKAGE_ONBOARD_UPDATER=y
BR2_PACKAGE_WAFFLE_SUPPORTS_GLX=y
BR2_PACKAGE_WAFFLE_SUPPORTS_WAYLAND=y
BR2_PACKAGE_WAFFLE_SUPPORTS_X11_EGL=y
BR2_PACKAGE_WAFFLE_SUPPORTS_GBM=y
BR2_PACKAGE_WAFFLE=y
BR2_PACKAGE_PIGLIT=y
```

## dashcam/package/camera-api/Config.in
```kconfig
config BR2_PACKAGE_CAMERA_API
	bool "camera-api"
	select BR2_PACKAGE_HOST_ZIG_X86_86
	help
	  The API portion of the Capable camera firmware.
```

## dashcam/package/camera-bridge/Config.in
```kconfig
config BR2_PACKAGE_CAMERA_BRIDGE
	bool "camera-bridge"
  select BR2_PACKAGE_BOOST
  select BR2_PACKAGE_BOOST_PROGRAM_OPTIONS
  select BR2_PACKAGE_BOOST_FILESYSTEM
  select BR2_PACKAGE_LIBCAMERA
  select BR2_PACKAGE_LIBCAMERA_PIPELINE_RASPBERRYPI
  select BR2_PACKAGE_JPEG_TURBO
  select BR2_PACKAGE_JSON_FOR_MODERN_CPP
	help
	  The C++ portion of the Capable camera firmware which bridges libcamera.
```

## dashcam/package/camera-scripts/Config.in
```kconfig
config BR2_PACKAGE_CAMERA_SCRIPTS
	bool "camera-scripts"
	help
	  General utility scripts
```

## dashcam/package/data-logger/Config.in
```kconfig
config BR2_PACKAGE_DATA_LOGGER
	bool "data-logger"
	depends on BR2_PACKAGE_HOST_GO_TARGET_ARCH_SUPPORTS
	help
	  System data logger
```

## dashcam/package/gnss-logger/Config.in
```kconfig
config BR2_PACKAGE_GNSS_LOGGER
	bool "gpsd-logger"
  select BR2_PACKAGE_GPSD_AND_CONFIG
  select BR2_PACKAGE_BOOST
  select BR2_PACKAGE_BOOST_PROGRAM_OPTIONS
  select BR2_PACKAGE_JSON_FOR_MODERN_CPP
	help
	  System GNSS logger
```

## dashcam/package/gpsd-and-config/Config.in
```kconfig
config BR2_PACKAGE_GPSD_AND_CONFIG
	bool "gpsd-and-config"
  select BR2_PACKAGE_GPSD
  select BR2_PACKAGE_GPSD_CLIENT_DEBUG
  select BR2_PACKAGE_GPSD_OLDSTYLE
  select BR2_PACKAGE_GPSD_NMEA
  select BR2_PACKAGE_GPSD_UBX
	help
	  Add GPSD and configuration for attached device
```

## dashcam/package/imu-logger/Config.in
```kconfig
config BR2_PACKAGE_IMU_LOGGER
	bool "imu-logger"
  select BR2_PACKAGE_BOOST
  select BR2_PACKAGE_BOOST_PROGRAM_OPTIONS
  select BR2_PACKAGE_JSON_FOR_MODERN_CPP
	help
	  IMU logger
```

## dashcam/package/led-controller/Config.in
```kconfig
config BR2_PACKAGE_LED_CONTROLLER
	bool "led-controller"
  select BR2_PACKAGE_BOOST
  select BR2_PACKAGE_BOOST_PROGRAM_OPTIONS
  select BR2_PACKAGE_JSON_FOR_MODERN_CPP
	help
	  LED controller via json configuration file
```

## dashcam/package/lorawan-logger/Config.in
```kconfig
config BR2_PACKAGE_LORAWAN_LOGGER
	bool "lorawan-logger"
	help
	  LoraWan SPI support
```

## dashcam/package/object-detection/Config.in
```kconfig
config BR2_PACKAGE_OBJECT_DETECTION
	bool "object-detection"
    select BR2_PACKAGE_PYTHON3
```

## dashcam/package/onboard-updater/Config.in
```kconfig
config BR2_PACKAGE_ONBOARD_UPDATER
	bool "onboard-updater"
  select BR2_PACKAGE_PYTHON3
	select BR2_PACKAGE_PYTHON_TRANSITIONS
	help
	  The onboard updater that manages the OTAU.
```

## dashcam/package/yolov8/Config.in
```kconfig
config BR2_PACKAGE_YOLOV8
	bool "yolov8"
    select BR2_PACKAGE_PYTHON3
	select BR2_PACKAGE_PYTHON_REQUESTS
	select BR2_PACKAGE_PYTHON_GITPYTHON
	select BR2_PACKAGE_PYTHON_MATPLOTLIB
	select BR2_PACKAGE_PYTHON_PILLOW
	select BR2_PACKAGE_PYTHON_PSUTIL
	select BR2_PACKAGE_PYTHON_PYBIND11
	select BR2_PACKAGE_PYTHON_PYYAML
	# select BR2_PACKAGE_PYTHON_ULTRALYTICS # trying out to reduce the size of the partitions
	select BR2_PACKAGE_OPENCV4
	select BR2_PACKAGE_OPENCV4_LIB_PYTHON
	select BR2_PACKAGE_PYTHON_PIP
	select BR2_PACKAGE_PYTHON_PROTOBUF
	select BR2_PACKAGE_PYTHON_SYMPY
	select BR2_PACKAGE_PYTHON_MPMATH
	select BR2_PACKAGE_PYTHON_HUMANFRIENDLY
	select BR2_PACKAGE_PYTHON_NUMPY
	# dependencies for opencv_python
	select BR2_PACKAGE_READLINE
	select BR2_PACKAGE_PYTHON_WHEEL
	select BR2_PACKAGE_PYTHON_DISTRO
	select BR2_PACKAGE_PYTHON_SCIKIT_BUILD
	# dependencies for opencv_python
	# select BR2_PACKAGE_PYTHON_ASTUNPARSE
	# select BR2_PACKAGE_PYTHON_EXPECTTEST
	# select BR2_PACKAGE_PYTHON_HYPOTHESIS
	# select BR2_PACKAGE_PYTHON_TYPES_DATACLASSES
	# select BR2_PACKAGE_PYTHON_TYPING_EXTENSIONS
	# select BR2_PACKAGE_PYTHON_FILELOCK
	# select BR2_PACKAGE_PYTHON_NETWORKX
	# select BR2_PACKAGE_PYTHON_JINJA2
	# Add inotify + nose as dependencies
	select BR2_PACKAGE_PYTHON_INOTIFY
	select BR2_PACKAGE_CPULIMIT
	help
	  Yolov8 package dependencies
```

## dashcam/package/zig-aarch64/Config.in
```kconfig
config BR2_PACKAGE_ZIG_AARCH64
	bool "zig-aarch64-target"
	help
	  Zig for the AARCH64 target, though we shouldn't need Zig on the target.
```

## dashcam/package/zig-x86-64/Config.in.host
```kconfig
config BR2_PACKAGE_HOST_ZIG_X86_86
	bool "zig-x86-64-host"
	help
	  Zig for the x86_64 host.
```
